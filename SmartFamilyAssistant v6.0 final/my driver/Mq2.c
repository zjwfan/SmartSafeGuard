#include<Option.h>


sbit DOUT_MQ2=P2^1;//P5^5; 

//void Mq2Init(void);
unsigned char Mq2Read(void);
void delay_MQ2(void);
/****************************************************************
*函数功能 ：延时函数										
*入口参数 ：无												
*返 回 值 ：无							
*说    明 ：				
****************************************************************/
void delay_MQ2(void)
{
    char m,n,s;
    for(m=20;m>0;m--)
    for(n=20;n>0;n--)
    for(s=248;s>0;s--);
}

/****************************************************************
*函数功能 ：初始化气体浓度读取端口										
*入口参数 ：无												
*返 回 值 ：无							
*说    明 ：					
****************************************************************/
//void Mq2Init(void)
//{
//  P0SEL &= ~0x01;//让P00为普通IO口，
//  P0DIR &= ~0x01;//让P00为输入 
//  P0INP &= ~0x01;//设置P00为上拉或下拉模式
//  P2INP |= 0x10;//设置P01为下拉
//}

/****************************************************************
*函数功能 ：读取气体浓度，检查其是否超标										
*入口参数 ：无												
*返 回 值 ：无							
*说    明 ：					
****************************************************************/
unsigned char Mq2Read(void)
{
   int result;
   
   if(DOUT_MQ2==0)        //当浓度高于设定值时 ，执行条件函数
   {
      delay_MQ2();        //延时抗干扰
      if(DOUT_MQ2==0)     //确定 浓度高于设定值时 ，执行条件函数
      {
       result = 1;
      }
   }
   else
   {
     result = 0;
   }
   return result;
}
